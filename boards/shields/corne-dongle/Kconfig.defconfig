## boards/shields/corne-pandakb/Kconfig.shield
```kconfig
config SHIELD_CORNE_DONGLE
	def_bool $(shields_list_contains,corne_dongle)

config SHIELD_PANDAKB_LEFT
	def_bool $(shields_list_contains,pandakb_left)

config SHIELD_PANDAKB_RIGHT
	def_bool $(shields_list_contains,pandakb_right)
```

## boards/shields/corne/Kconfig.shield
```kconfig
# Copyright (c) 2020 Pete Johanson
# SPDX-License-Identifier: MIT

config SHIELD_CORNE_DONGLE
	def_bool $(shields_list_contains,corne_dongle)
```

## config/west.yml
```yaml
manifest:
  remotes:
    - name: zmkfirmware
      url-base: https://github.com/zmkfirmware
    - name: carrefinho
      url-base: https://github.com/carrefinho
    - name: mctechnology17
      url-base: https://github.com/mctechnology17
  projects:
    - name: zmk
      remote: zmkfirmware
      revision: main
      import: app/west.yml
    - name: prospector-zmk-module
      remote: carrefinho
      revision: main
    - name: zmk-nice-oled
      remote: mctechnology17
      revision: main
  self:
    path: config
```
